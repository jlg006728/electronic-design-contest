/**
 * Minimal SysConfig for the E-car code package.
 *
 * This file intentionally configures only the MSPM0G3507 device, board, and
 * default system clock. Real project pins and peripherals are initialized in
 * board.c so the code can be copied into a CCS empty project without editing
 * the SysConfig GUI.
 *
 * Important:
 * - Keep the CCS project path in English. Chinese paths can make SysConfig CLI
 *   pass a garbled script path.
 * - Do not add the motor/servo/UART pins here unless you also remove the manual
 *   initialization in board.c.
 */
//@cliArgs --device "MSPM0G350X" --package "LQFP-64(PM)" --part "Default"
//@v2CliArgs --device "MSPM0G3507" --package "LQFP-64(PM)"
// @cliArgs --board /ti/boards/LP_MSPM0G3507 --rtos nortos

const SYSCTL = scripting.addModule("/ti/driverlib/SYSCTL");
const Board = scripting.addModule("/ti/driverlib/Board", {}, false);

SYSCTL.forceDefaultClkConfig = true;
